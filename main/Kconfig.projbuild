## main/Kconfig.projbuild
```kconfig
menu "SPP Example Configuration"
    config EXAMPLE_SSP_ENABLED
        bool "Secure Simple Pairing"
        depends on BT_CLASSIC_ENABLED
        default y
        help
            This enables the Secure Simple Pairing. If disable this option,
            Bluedroid will only support Legacy Pairing

    config EXAMPLE_LOCAL_DEVICE_NAME
        string "Local Device Name"
        default "ESP_SPP_ACCEPTOR"
        help
            Use this option to set local device name.
endmenu

menu "Tests"
    config PV_SDC_TESTS_ENABLED
    bool "Run SDC unit tests"
    default n
    help
        This will run the unit tests after each boot. WARNING: This may alter contents of the SD card.

    config PV_DEVICELIST_TESTS_ENABLED
    bool "Run devicelist unit tests"
    default n
    help
        This will run the unit tests after each boot. WARNING: This wll alter any existing devicelist on the device.
endmenu

config FORMAT_SDCARD_ON_START
bool "Format SD on reset"
default n
help
    Enabling this will format the SD card on every board reset. All data on SD Card will be erased on reset. Use only for testing.
```
